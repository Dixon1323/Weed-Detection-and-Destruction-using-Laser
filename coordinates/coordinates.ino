#include <Servo.h>


Servo x_sevo;
Servo y_servo;

bool status=false;
long int current=0,previous=0;
int interval=20000;

int x_angle = 0;
int y_angle = 0;
int x_axis[257] = { 0, 99, 91, 87, 81, 75, 71, 65, 58, 52, 48, 43, 38, 31, 26, 21, 16,
                    99, 91, 87, 81, 75, 71, 65, 58, 52, 48, 43, 38, 31, 26, 21, 16,
                    99, 91, 87, 81, 75, 71, 65, 58, 52, 48, 43, 38, 41, 26, 21, 16,
                    99, 91, 87, 81, 75, 71, 65, 58, 52, 48, 43, 38, 31, 26, 21, 16,
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                    100, 91, 87, 81, 75, 71, 65, 58, 52, 48, 43, 38, 31, 26, 21, 16 };


int y_axis[257] = { 0, 58, 57, 57, 57, 57, 57, 57, 57, 57, 60, 60, 60, 60, 60, 60, 60,                 //first row 1 - 16
                    60, 60, 62, 62, 62, 62, 62, 62, 62, 62, 62, 63, 63, 63, 65, 65,                    //second row 17 - 32
                    64, 64, 66, 66, 66, 66, 66, 66, 66, 66, 67, 67, 67, 67, 68, 69,                    //third row 33 - 48
                    68, 68, 70, 70, 70, 70, 70, 70, 70, 70, 71, 71, 71, 71, 72, 73,                    //fourth row 49 - 64
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                    118, 118, 120, 120, 122, 122, 122, 122, 122, 123, 123, 122, 121, 121, 121, 121 };  //241 - 256


void setup() {
  Serial.begin(9600);
  pinMode(A0, INPUT);
  pinMode(D4,OUTPUT);
  digitalWrite(D4,HIGH);
  x_sevo.attach(D1);
  y_servo.attach(D2);
  x_sevo.write(90);
  y_servo.write(90);

  while (!Serial) {
    ;
  }
}

void loop() {
  current=millis();
  if (Serial.available() > 0) {
    digitalWrite(D4,LOW);
    status=true;
    int value = Serial.parseInt();
    Serial.print("Received Value : ");
    Serial.println(value);
    if (value != 0 && value<=256) {
      x_angle = x_axis[value];
      y_angle = y_axis[value];
      Serial.print("X Axis : ");
      Serial.println(x_angle);
      Serial.print("Y Axis : ");
      Serial.println(y_angle);
      x_sevo.write(x_angle);
      delay(15);
      y_servo.write(y_angle);
      delay(15);
    }
    // delay(500);
  }
  if ((current-previous>=interval) && (status==true)){
    previous=current;
    digitalWrite(D4, HIGH);
    status=false;
  }
}

// void loop() {
//   int number = random(1, 257);
//   Serial.println("**********************************");
//   Serial.print("Random number : ");
//   Serial.println(number);
//   Serial.println("**********************************");
//   x_angle = x_axis[number];
//   y_angle = y_axis[number];
//   Serial.print("X Axis : ");
//   Serial.println(x_angle);
//   Serial.print("Y Axis : ");
//   Serial.println(y_angle);
//   x_sevo.write(x_angle);
//   delay(50);
//   y_servo.write(y_angle);
//   delay(5000);
// }